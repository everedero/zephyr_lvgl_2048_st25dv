/*
 * Copyright (c) 2024, Eve Redero
 *
 * SPDX-License-Identifier: Apache-2.0
 */

#include <zephyr/dt-bindings/input/input-event-codes.h>
/* TODO this include fails, send an SOS*/
//#include <zephyr/dt-bindings/lvgl/lvgl.h>
/* In the meantime using magic numbers
    LV_KEY_UP        = 17,  0x11
    LV_KEY_DOWN      = 18,  0x12
    LV_KEY_RIGHT     = 19,  0x13
    LV_KEY_LEFT      = 20,  0x14
    LV_KEY_ESC       = 27,  0x1B
    LV_KEY_DEL       = 127, 0x7F
    LV_KEY_BACKSPACE = 8,   0x08
    LV_KEY_ENTER     = 10,  0x0A
    LV_KEY_NEXT      = 9,   0x09
    LV_KEY_PREV      = 11,  0x0B
    LV_KEY_HOME      = 2,   0x02
    LV_KEY_END       = 3,   0x03
*/

/ {
	pointer {
		compatible = "zephyr,lvgl-pointer-input";
		input = <&stmpe811>;
		invert-y;
	};

	keypad {
		compatible = "zephyr,lvgl-keypad-input";
		input = <&buttons>;
		input-codes = <INPUT_KEY_RIGHT INPUT_KEY_LEFT INPUT_KEY_UP INPUT_KEY_DOWN INPUT_KEY_ENTER>;
		/*lvgl-codes = <LV_KEY_RIGHT LV_KEY_LEFT LV_KEY_UP LV_KEY_DOWN LV_KEY_ENTER>;*/
		lvgl-codes = <0x13 0x14 0x11 0x12 0x0A>;
	};

};
