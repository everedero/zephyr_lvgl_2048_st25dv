## boards/arm/st25dv_disco/Kconfig.board
```kconfig
# ST25DV DISCOVERY board configuration

# Copyright (c) 2024 Eve Redero
# SPDX-License-Identifier: Apache-2.0

config BOARD_ST25DV_DISCO
	bool "ST25DV discovery board"
	depends on SOC_STM32F405XG
```

## boards/arm/st25dv_disco/Kconfig.defconfig
```kconfig
# ST25DV DISCOVERY board configuration

# Copyright (c) 2024 Eve Redero
# SPDX-License-Identifier: Apache-2.0

#if BOARD_ST25DV_DISCO
if BOARD_ST25DV_DISCO

config BOARD
	default "stm32f405Xg"

config SPI_STM32_INTERRUPT
	default y
	depends on SPI

endif # BOARD_STM25DV_DISCO
```

## boards/arm/st25dv_mb1283_disco/Kconfig.board
```kconfig
# ST25DV DISCOVERY board configuration

# Copyright (c) 2024 Eve Redero
# SPDX-License-Identifier: Apache-2.0

config BOARD_ST25DV_MB1283_DISCO
	bool "ST25DV discovery board with MB1283"
	depends on SOC_STM32F405XG
```

## boards/st/st25dv_mb1283_disco/Kconfig.defconfig
```kconfig
# ST25DV DISCOVERY board configuration

# Copyright (c) 2024 Eve Redero
# SPDX-License-Identifier: Apache-2.0

#if BOARD_ST25DV_MB1283_DISCO
if BOARD_ST25DV_MB1283_DISCO

config BOARD
	default "st25dv_mb1283_disco"

config SPI_STM32_INTERRUPT
	default y
	depends on SPI

endif # BOARD_STM25DV_MB1283_DISCO
```
